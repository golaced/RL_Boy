#include "include.h"
#include "imu.h"
#include "rc.h"
#include "bat.h"
#include "usart_fc.h"
#include "imu.h"
#include "time.h"
#include "eso.h"
#include "rc_mine.h"
#include "nav.h"
#include "usbd_cdc_vcp.h" 


int PARAM_NRF[18][3];
int PARAM_RC[18][3];
u8 KEY[8];

u8 send_pid=0,read_pid=0;;
u16 data_rate;
u8 key_rc_reg[7][MID_RC_KEY];
float RC_GET[4][MID_RC_GET];
void NRF_DataAnl(void)
{ 

u8 temp;
	u8 i=0,j,sum = 0;
	for( i=0;i<31;i++)
		sum += NRF24L01_RXDATA[i];
	if(!(sum==NRF24L01_RXDATA[31]))	
	{i=0;
		return;
		}	 
	if(NRF24L01_RXDATA[0]==0x01)								
	{ 
		module.nrf=2;
		module.nrf_loss_cnt=0;
		data_rate++;
		Rc_Get.THROTTLE = (vs16)(NRF24L01_RXDATA[1]<<8)|NRF24L01_RXDATA[2];
		Rc_Get.YAW			= (vs16)(NRF24L01_RXDATA[3]<<8)|NRF24L01_RXDATA[4];
		Rc_Get.ROLL		  = (vs16)(NRF24L01_RXDATA[5]<<8)|NRF24L01_RXDATA[6];
		Rc_Get.PITCH 		= (vs16)(NRF24L01_RXDATA[7]<<8)|NRF24L01_RXDATA[8];
		Rc_Get.AUX1			= (vs16)(NRF24L01_RXDATA[9]<<8)|NRF24L01_RXDATA[10];
		Rc_Get.AUX2			= (vs16)(NRF24L01_RXDATA[11]<<8)|NRF24L01_RXDATA[12];
		Rc_Get.AUX3			= (vs16)(NRF24L01_RXDATA[13]<<8)|NRF24L01_RXDATA[14];
		Rc_Get.AUX4			= (vs16)(NRF24L01_RXDATA[15]<<8)|NRF24L01_RXDATA[16];
		Rc_Get.AUX5			= (vs16)(NRF24L01_RXDATA[17]<<8)|NRF24L01_RXDATA[18];
		
	  KEY[0]=(NRF24L01_RXDATA[19])&0x01;
		KEY[1]=(NRF24L01_RXDATA[19]>>1)&0x01;
		KEY[2]=(NRF24L01_RXDATA[19]>>2)&0x01;
		KEY[3]=(NRF24L01_RXDATA[19]>>3)&0x01;
		KEY[4]=(NRF24L01_RXDATA[19]>>4)&0x01;
		
		temp=NRF24L01_RXDATA[21];
		if(temp==1)
			read_pid=1;
	 }
	else if(NRF24L01_RXDATA[0]==0x02)//pid1
	{
	  PARAM_NRF[0][0] = (vs16)(NRF24L01_RXDATA[1]<<8)|NRF24L01_RXDATA[2];
		PARAM_NRF[0][1]	= (vs16)(NRF24L01_RXDATA[3]<<8)|NRF24L01_RXDATA[4];
		PARAM_NRF[0][2]	= (vs16)(NRF24L01_RXDATA[5]<<8)|NRF24L01_RXDATA[6];
		
		PARAM_NRF[1][0] = (vs16)(NRF24L01_RXDATA[7]<<8)|NRF24L01_RXDATA[8];
		PARAM_NRF[1][1]	= (vs16)(NRF24L01_RXDATA[9]<<8)|NRF24L01_RXDATA[10];
		PARAM_NRF[1][2]	= (vs16)(NRF24L01_RXDATA[11]<<8)|NRF24L01_RXDATA[12];

		PARAM_NRF[2][0] = (vs16)(NRF24L01_RXDATA[13]<<8)|NRF24L01_RXDATA[14];
		PARAM_NRF[2][1]	= (vs16)(NRF24L01_RXDATA[15]<<8)|NRF24L01_RXDATA[16];
		PARAM_NRF[2][2]	= (vs16)(NRF24L01_RXDATA[17]<<8)|NRF24L01_RXDATA[18];

		PARAM_NRF[3][0] = (vs16)(NRF24L01_RXDATA[19]<<8)|NRF24L01_RXDATA[20];
		PARAM_NRF[3][1]	= (vs16)(NRF24L01_RXDATA[21]<<8)|NRF24L01_RXDATA[22];
		PARAM_NRF[3][2]	= (vs16)(NRF24L01_RXDATA[23]<<8)|NRF24L01_RXDATA[24];
		
		PARAM_NRF[4][0] = (vs16)(NRF24L01_RXDATA[25]<<8)|NRF24L01_RXDATA[26];
		PARAM_NRF[4][1]	= (vs16)(NRF24L01_RXDATA[27]<<8)|NRF24L01_RXDATA[28];
		PARAM_NRF[4][2]	= (vs16)(NRF24L01_RXDATA[29]<<8)|NRF24L01_RXDATA[30];
	
	}
	else if(NRF24L01_RXDATA[0]==0x03)//pid2
	{
	  PARAM_NRF[5][0] = (vs16)(NRF24L01_RXDATA[1]<<8)|NRF24L01_RXDATA[2];
		PARAM_NRF[5][1]	= (vs16)(NRF24L01_RXDATA[3]<<8)|NRF24L01_RXDATA[4];
		PARAM_NRF[5][2]	= (vs16)(NRF24L01_RXDATA[5]<<8)|NRF24L01_RXDATA[6];
		
		PARAM_NRF[6][0] = (vs16)(NRF24L01_RXDATA[7]<<8)|NRF24L01_RXDATA[8];
		PARAM_NRF[6][1]	= (vs16)(NRF24L01_RXDATA[9]<<8)|NRF24L01_RXDATA[10];
		PARAM_NRF[6][2]	= (vs16)(NRF24L01_RXDATA[11]<<8)|NRF24L01_RXDATA[12];

		PARAM_NRF[7][0] = (vs16)(NRF24L01_RXDATA[13]<<8)|NRF24L01_RXDATA[14];
		PARAM_NRF[7][1]	= (vs16)(NRF24L01_RXDATA[15]<<8)|NRF24L01_RXDATA[16];
		PARAM_NRF[7][2]	= (vs16)(NRF24L01_RXDATA[17]<<8)|NRF24L01_RXDATA[18];

		PARAM_NRF[8][0] = (vs16)(NRF24L01_RXDATA[19]<<8)|NRF24L01_RXDATA[20];
		PARAM_NRF[8][1]	= (vs16)(NRF24L01_RXDATA[21]<<8)|NRF24L01_RXDATA[22];
		PARAM_NRF[8][2]	= (vs16)(NRF24L01_RXDATA[23]<<8)|NRF24L01_RXDATA[24];
		
		PARAM_NRF[9][0] = (vs16)(NRF24L01_RXDATA[25]<<8)|NRF24L01_RXDATA[26];
		PARAM_NRF[9][1]	= (vs16)(NRF24L01_RXDATA[27]<<8)|NRF24L01_RXDATA[28];
		PARAM_NRF[9][2]	= (vs16)(NRF24L01_RXDATA[29]<<8)|NRF24L01_RXDATA[30];
	}
	else if(NRF24L01_RXDATA[0]==0x04)//pid3
	{
	  PARAM_NRF[10][0] = (vs16)(NRF24L01_RXDATA[1]<<8)|NRF24L01_RXDATA[2];
		PARAM_NRF[10][1]	= (vs16)(NRF24L01_RXDATA[3]<<8)|NRF24L01_RXDATA[4];
		PARAM_NRF[10][2]	= (vs16)(NRF24L01_RXDATA[5]<<8)|NRF24L01_RXDATA[6];
		
		PARAM_NRF[11][0] = (vs16)(NRF24L01_RXDATA[7]<<8)|NRF24L01_RXDATA[8];
		PARAM_NRF[11][1]	= (vs16)(NRF24L01_RXDATA[9]<<8)|NRF24L01_RXDATA[10];
		PARAM_NRF[11][2]	= (vs16)(NRF24L01_RXDATA[11]<<8)|NRF24L01_RXDATA[12];

		PARAM_NRF[12][0] = (vs16)(NRF24L01_RXDATA[13]<<8)|NRF24L01_RXDATA[14];
		PARAM_NRF[12][1]	= (vs16)(NRF24L01_RXDATA[15]<<8)|NRF24L01_RXDATA[16];
		PARAM_NRF[12][2]	= (vs16)(NRF24L01_RXDATA[17]<<8)|NRF24L01_RXDATA[18];

		PARAM_NRF[13][0] = (vs16)(NRF24L01_RXDATA[19]<<8)|NRF24L01_RXDATA[20];
		PARAM_NRF[13][1]	= (vs16)(NRF24L01_RXDATA[21]<<8)|NRF24L01_RXDATA[22];
		PARAM_NRF[13][2]	= (vs16)(NRF24L01_RXDATA[23]<<8)|NRF24L01_RXDATA[24];
		
		PARAM_NRF[14][0] = (vs16)(NRF24L01_RXDATA[25]<<8)|NRF24L01_RXDATA[26];
		PARAM_NRF[14][1]	= (vs16)(NRF24L01_RXDATA[27]<<8)|NRF24L01_RXDATA[28];
		PARAM_NRF[14][2]	= (vs16)(NRF24L01_RXDATA[29]<<8)|NRF24L01_RXDATA[30];
	}
	else if(NRF24L01_RXDATA[0]==0x05)//pid3
	{
	  PARAM_NRF[15][0] = (vs16)(NRF24L01_RXDATA[1]<<8)|NRF24L01_RXDATA[2];
		PARAM_NRF[15][1]	= (vs16)(NRF24L01_RXDATA[3]<<8)|NRF24L01_RXDATA[4];
		PARAM_NRF[15][2]	= (vs16)(NRF24L01_RXDATA[5]<<8)|NRF24L01_RXDATA[6];
		
		PARAM_NRF[16][0] = (vs16)(NRF24L01_RXDATA[7]<<8)|NRF24L01_RXDATA[8];
		PARAM_NRF[16][1]	= (vs16)(NRF24L01_RXDATA[9]<<8)|NRF24L01_RXDATA[10];
		PARAM_NRF[16][2]	= (vs16)(NRF24L01_RXDATA[11]<<8)|NRF24L01_RXDATA[12];

		PARAM_NRF[17][0] = (vs16)(NRF24L01_RXDATA[13]<<8)|NRF24L01_RXDATA[14];
		PARAM_NRF[17][1]	= (vs16)(NRF24L01_RXDATA[15]<<8)|NRF24L01_RXDATA[16];
		PARAM_NRF[17][2]	= (vs16)(NRF24L01_RXDATA[17]<<8)|NRF24L01_RXDATA[18];

		send_pid=1;
	}
}


void Nrf_Check_Event(float dt)
{ 
	u8 rx_len =0;
	static float cnt_loss_rc=0;
	u8 sta;

	sta= NRF_Read_Reg(NRF_READ_REG + NRFRegSTATUS);		

	if(sta & (1<<RX_DR))	 
	{ 
		cnt_loss_rc=0;
			
				rx_len= NRF_Read_Reg(R_RX_PL_WID);			
				if(rx_len<33)
				{
					NRF_Read_Buf(RD_RX_PLOAD,NRF24L01_RXDATA,RX_PLOAD_WIDTH);// read receive payload from RX_FIFO buffer
					NRF_DataAnl();
					NRF_Write_Reg(FLUSH_RX,0xff);
				}
				else 
				{ 
					NRF_Write_Reg(FLUSH_RX,0xff );
				}
		}
	else//---------losing_nrf
	{	 	
	   cnt_loss_rc+=dt;
		 if(cnt_loss_rc>0.5 )//0.5ms
		 { cnt_loss_rc=0;
			 NRF_Write_Reg(FLUSH_RX,0xff);
		 }
  }
	if(sta & (1<<TX_DS))	
	{
	
	}

	if(sta & (1<<MAX_RT))
	{
		if(sta & 0x01)	//TX FIFO FULL
		{
			NRF_Write_Reg(FLUSH_TX,0xff);
		}
	}
	NRF_Write_Reg(NRF_WRITE_REG + NRFRegSTATUS, sta);
}
